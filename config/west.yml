## config/west.yml
```yaml
manifest:
  remotes:    
    - name: aroum
      url-base: https://github.com/aroum
  projects:
    - name: zmk
      remote: aroum
      revision: v0.3.0
      import: app/west.yml
  self:
    path: config
```
